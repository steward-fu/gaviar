## opensbi/lib/utils/clock/Kconfig
```kconfig
# SPDX-License-Identifier: BSD-2-Clause

menu "Clock Support"

config CLOCK_F133
	bool "F133 clock support"
	default n

endmenu
```

## opensbi/lib/utils/display/Kconfig
```kconfig
# SPDX-License-Identifier: BSD-2-Clause

menu "Display Support"

config DISPLAY_F133_SLCD
	bool "F133 slcd support"
	default n

endmenu
```

## opensbi/lib/utils/dram/Kconfig
```kconfig
# SPDX-License-Identifier: BSD-2-Clause

menu "DRAM Support"

config DRAM_F133
	bool "F133 dram support"
	default n

endmenu
```

## opensbi/lib/utils/led/Kconfig
```kconfig
# SPDX-License-Identifier: BSD-2-Clause

menu "LED Support"

config LED_F133
	bool "F133 led support"
	default n

endmenu
```

## opensbi/lib/utils/mmc/Kconfig
```kconfig
# SPDX-License-Identifier: BSD-2-Clause

menu "MMC Support"

config MMC_F133
	bool "F133 mmc support"
	default n

endmenu
```

## opensbi/platform/allwinner/f133/Kconfig
```kconfig
# SPDX-License-Identifier: BSD-2-Clause

config PLATFORM_F133
	bool
	select LED_F133
	select MMC_F133
	select DRAM_F133
	select CLOCK_F133
	select SERIAL_F133_UART
	select DISPLAY_F133_SLCD
	default y
```
